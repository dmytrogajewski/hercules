## pkg/uast/uastmaps/kconfig.uastmap
```kconfig
expression <- (expression) => uast(
    type: "Synthetic"
)

binary_expression <- (binary_expression) => uast(
    type: "Synthetic",
    children: "expression"
)

choice <- (choice) => uast(
    type: "Synthetic",
    children: "name"
)

comment_entry <- (comment_entry) => uast(
    type: "Comment",
    roles: "Comment",
    children: "string"
)

conditional_clause <- (conditional_clause) => uast(
    type: "Synthetic"
)

config <- (config) => uast(
    type: "Synthetic",
    children: "name"
)

configdefault <- (configdefault) => uast(
    type: "Synthetic",
    children: "name"
)

configuration <- (configuration) => uast(
    type: "Synthetic"
)

default_value <- (default_value) => uast(
    type: "Synthetic"
)

dependencies <- (dependencies) => uast(
    type: "Synthetic"
)

help_text <- (help_text) => uast(
    type: "Synthetic"
)

if <- (if) => uast(
    type: "If",
    children: "expression"
)

input_prompt <- (input_prompt) => uast(
    type: "Synthetic"
)

limiting_menu_display <- (limiting_menu_display) => uast(
    type: "Synthetic"
)

macro_variable <- (macro_variable) => uast(
    type: "Variable",
    roles: "Variable", "Declaration"
)

mainmenu <- (mainmenu) => uast(
    type: "Synthetic",
    children: "string"
)

menu <- (menu) => uast(
    type: "Synthetic",
    children: "string"
)

menuconfig <- (menuconfig) => uast(
    type: "Synthetic",
    children: "name"
)

name <- (name) => uast(
    type: "Synthetic"
)

numerical_ranges <- (numerical_ranges) => uast(
    type: "Synthetic"
)

parenthesized_expression <- (parenthesized_expression) => uast(
    type: "Synthetic"
)

reverse_dependencies <- (reverse_dependencies) => uast(
    type: "Synthetic"
)

source <- (source) => uast(
    type: "Synthetic"
)

string <- (string) => uast(
    type: "Synthetic"
)

text <- (text) => uast(
    type: "Synthetic"
)

type_definition <- (type_definition) => uast(
    type: "Synthetic"
)

type_definition_default <- (type_definition_default) => uast(
    type: "Synthetic"
)

unary_expression <- (unary_expression) => uast(
    type: "Synthetic"
)

variable <- (variable) => uast(
    type: "Variable",
    roles: "Variable", "Declaration",
    children: "expression", "symbol"
)

weak_reverse_dependencies <- (weak_reverse_dependencies) => uast(
    type: "Synthetic"
)

bool <- (bool) => uast(
    type: "Synthetic"
)

choice <- (choice) => uast(
    type: "Synthetic"
)

comment <- (comment) => uast(
    type: "Comment",
    roles: "Comment"
)

comment <- (comment) => uast(
    type: "Comment",
    roles: "Comment"
)

config <- (config) => uast(
    type: "Synthetic"
)

configdefault <- (configdefault) => uast(
    type: "Synthetic"
)

def_bool <- (def_bool) => uast(
    type: "Synthetic"
)

def_hex <- (def_hex) => uast(
    type: "Synthetic"
)

def_int <- (def_int) => uast(
    type: "Synthetic"
)

def_string <- (def_string) => uast(
    type: "Synthetic"
)

def_tristate <- (def_tristate) => uast(
    type: "Synthetic"
)

default <- (default) => uast(
    type: "Synthetic"
)

endchoice <- (endchoice) => uast(
    type: "Synthetic"
)

endif <- (endif) => uast(
    type: "If"
)

endmenu <- (endmenu) => uast(
    type: "Synthetic"
)

help <- (help) => uast(
    type: "Synthetic"
)

hex <- (hex) => uast(
    type: "Synthetic"
)

if <- (if) => uast(
    type: "If"
)

imply <- (imply) => uast(
    type: "Synthetic"
)

int <- (int) => uast(
    type: "Synthetic"
)

macro_content <- (macro_content) => uast(
    type: "Synthetic"
)

mainmenu <- (mainmenu) => uast(
    type: "Synthetic"
)

menu <- (menu) => uast(
    type: "Synthetic"
)

menuconfig <- (menuconfig) => uast(
    type: "Synthetic"
)

modules <- (modules) => uast(
    type: "Module",
    roles: "Module"
)

optional <- (optional) => uast(
    type: "Synthetic"
)

orsource <- (orsource) => uast(
    type: "Synthetic"
)

osource <- (osource) => uast(
    type: "Synthetic"
)

prompt <- (prompt) => uast(
    type: "Synthetic"
)

range <- (range) => uast(
    type: "Synthetic"
)

rsource <- (rsource) => uast(
    type: "Synthetic"
)

select <- (select) => uast(
    type: "Synthetic"
)

source <- (source) => uast(
    type: "Synthetic"
)

string <- (string) => uast(
    type: "Synthetic"
)

string_content <- (string_content) => uast(
    type: "Synthetic"
)

symbol <- (symbol) => uast(
    type: "Synthetic"
)

tristate <- (tristate) => uast(
    type: "Synthetic"
)
```
